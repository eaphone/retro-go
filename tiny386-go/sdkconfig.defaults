## tiny386-go/sdkconfig.defaults
```kconfig
# ESP32-P4 rev <3 has very limited sram_low (~179KB).
# All these settings default to y in ESP-IDF Kconfig but are not needed for retro-go.
CONFIG_LOG_IN_IRAM=n
CONFIG_ESP_ROM_PRINT_IN_IRAM=n
CONFIG_ESP_SYSTEM_IN_IRAM=n
CONFIG_LIBC_MISC_IN_IRAM=n
CONFIG_LIBC_LOCKS_PLACE_IN_IRAM=n
CONFIG_FREERTOS_IN_IRAM=n
CONFIG_ESP_TIMER_IN_IRAM=n
CONFIG_ESP_INTR_IN_IRAM=n
CONFIG_PM_SLEEP_FUNC_IN_IRAM=n
CONFIG_RTC_CLK_FUNC_IN_IRAM=n
CONFIG_RTC_TIME_FUNC_IN_IRAM=n
CONFIG_ESP_PERIPH_CTRL_FUNC_IN_IRAM=n
CONFIG_ESP_REGI2C_CTRL_FUNC_IN_IRAM=n
CONFIG_ESP_HW_SUPPORT_FUNC_IN_IRAM=n
CONFIG_GDMA_CTRL_FUNC_IN_IRAM=n
CONFIG_GDMA_ISR_HANDLER_IN_IRAM=n
CONFIG_RMT_ENCODER_FUNC_IN_IRAM=n
CONFIG_RMT_TX_ISR_HANDLER_IN_IRAM=n
CONFIG_RMT_RX_ISR_HANDLER_IN_IRAM=n
CONFIG_PARLIO_TX_ISR_HANDLER_IN_IRAM=n
CONFIG_PARLIO_RX_ISR_HANDLER_IN_IRAM=n
CONFIG_MCPWM_ISR_HANDLER_IN_IRAM=n
CONFIG_GPTIMER_ISR_HANDLER_IN_IRAM=n
CONFIG_I2C_MASTER_ISR_HANDLER_IN_IRAM=n
CONFIG_ANA_CMPR_ISR_HANDLER_IN_IRAM=n
CONFIG_SPI_SLAVE_ISR_IN_IRAM=n
CONFIG_SPI_MASTER_IN_IRAM=n
CONFIG_SPI_MASTER_ISR_IN_IRAM=n
CONFIG_SPI_FLASH_PLACE_FUNCTIONS_IN_IRAM=n
CONFIG_ESP_SPI_BUS_LOCK_ISR_FUNCS_IN_IRAM=n
CONFIG_ESP_SPI_BUS_LOCK_FUNCS_IN_IRAM=n
CONFIG_PERIPH_CTRL_FUNC_IN_IRAM=n
```
